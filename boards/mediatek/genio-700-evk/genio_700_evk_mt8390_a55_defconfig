## boards/mediatek/genio-700-evk/genio_700_evk_mt8390_a55_defconfig
```kconfig
#
# Copyright 2025 MediaTek
#
# SPDX-License-Identifier: Apache-2.0
#

# ARM Options
CONFIG_ARM64_VA_BITS_40=y
CONFIG_ARM64_PA_BITS_40=y
CONFIG_ARM_ARCH_TIMER=y
CONFIG_TIMER_READS_ITS_FREQUENCY_AT_RUNTIME=y

# Cache Options
CONFIG_CACHE_MANAGEMENT=y
CONFIG_DCACHE_LINE_SIZE_DETECT=y
CONFIG_ICACHE_LINE_SIZE_DETECT=y

# Enable GPIO
CONFIG_GPIO=y

# Serial Drivers
CONFIG_SERIAL=y
CONFIG_UART_INTERRUPT_DRIVEN=y
CONFIG_UART_USE_RUNTIME_CONFIGURE=y

# Enable Console
CONFIG_CONSOLE=y
CONFIG_CONSOLE_INPUT_MAX_LINE_LEN=256
CONFIG_CONSOLE_HANDLER=y
CONFIG_UART_CONSOLE=y

CONFIG_CLOCK_CONTROL=y
CONFIG_AUDIO=y
CONFIG_AUDIO_MEDIATEK_MT8390_AFE=y
CONFIG_CLOCK_CONTROL_MT8390_APMIXED=y
CONFIG_CLOCK_CONTROL_MT8390_TOPCKGEN=y

# Ensure the EINT interrupt driver is initialized early
CONFIG_INTC_INIT_PRIORITY=2
```

## drivers/audio/mediatek/mt8390/Kconfig.mt8390_afe
```kconfig
# Copyright (c) 2026 MediaTek
# SPDX-License-Identifier: Apache-2.0

config AUDIO_MEDIATEK_MT8390_AFE
	bool "MediaTek MT8390 AFE audio driver"
	default y
	depends on DT_HAS_MEDIATEK_MT8390_AFE_ENABLED
	depends on CLOCK_CONTROL_MT8390
	depends on CLOCK_CONTROL_MT8390_APMIXED
	depends on CLOCK_CONTROL_MT8390_TOPCKGEN
	select PINCTRL
	help
	  Enable the MediaTek MT8390 AFE (Audio Front End) driver.
	  Supports eTDM_IN and eTDM_OUT audio paths with DMA via
	  memory interface (memif) control registers.
```

## drivers/clock_control/Kconfig.mtk_clk
```kconfig
# Copyright 2026 MediaTek
# SPDX-License-Identifier: Apache-2.0

config CLOCK_CONTROL_MT8370
	bool "MT8370 clock control driver"
	default y
	depends on CLOCK_CONTROL
	depends on DT_HAS_MEDIATEK_MT8188_CLK_INFRA_A0_ENABLED
	help
	  Enable support for MediaTek MT8370 clock control driver.

config CLOCK_CONTROL_MT8390
	bool "MT8390 clock control driver"
	default y
	depends on CLOCK_CONTROL
	depends on DT_HAS_MEDIATEK_MT8188_CLK_INFRA_A0_ENABLED
	help
	  Enable support for MediaTek MT8390 clock control driver.

config CLOCK_CONTROL_MT8390_APMIXED
	bool "MT8390 APMIXEDSYS PLL clock driver"
	default y
	depends on CLOCK_CONTROL
	depends on DT_HAS_MEDIATEK_MT8390_APMIXEDSYS_ENABLED
	help
	  Enable the APMIXEDSYS PLL driver for MT8390 (APLL1/APLL2 audio PLLs).

config CLOCK_CONTROL_MT8390_TOPCKGEN
	bool "MT8390 TOPCKGEN mux+gate clock driver"
	default y
	depends on CLOCK_CONTROL
	depends on DT_HAS_MEDIATEK_MT8390_TOPCKGEN_ENABLED
	help
	  Enable the TOPCKGEN mux+gate clock driver for MT8390 audio CLK_TOP_* clocks.
```

## drivers/gpio/Kconfig.mtk_gpio
```kconfig
# MediaTek GPIO configuration options
# Copyright (c) 2025, MediaTek
# SPDX-License-Identifier: Apache-2.0

config GPIO_MT8365
	bool "MediaTek MT8365 GPIO driver"
	default y
	depends on SOC_MT8365
	depends on DT_HAS_MEDIATEK_MT8365_GPIO_ENABLED
	select PINCTRL
	help
	  Enable the MediaTek MT8365 GPIO driver.

config GPIO_MT8370
	bool "MediaTek MT8370 GPIO driver"
	default y
	depends on SOC_MT8370
	depends on DT_HAS_MEDIATEK_MT8188_GPIO_ENABLED
	select PINCTRL
	help
	  Enable the MediaTek MT8370 GPIO driver.

config GPIO_MT8390
	bool "MediaTek MT8390 GPIO driver"
	default y
	depends on SOC_MT8390
	depends on DT_HAS_MEDIATEK_MT8188_GPIO_ENABLED
	select PINCTRL
	help
	  Enable the MediaTek MT8390 GPIO driver.
```

## drivers/pinctrl/Kconfig.mtk_pinctrl
```kconfig
# MediaTek PINCTRL
# Copyright (c) 2025, MediaTek
# SPDX-License-Identifier: Apache-2.0

config PINCTRL_MT8365
	bool "MediaTek MT8365 PINCTRL driver"
	default y
	depends on SOC_MT8365
    depends on DT_HAS_MEDIATEK_MT8365_PINCTRL_ENABLED
	help
	  Enable the MediaTek MT8365 PINCTRL driver

config PINCTRL_MT8370
	bool "MediaTek MT8370 PINCTRL driver"
	default y
	depends on SOC_MT8370
    depends on DT_HAS_MEDIATEK_MT8188_PINCTRL_ENABLED
	help
	  Enable the MediaTek MT8370 PINCTRL driver.

config PINCTRL_MT8390
	bool "MediaTek MT8390 PINCTRL driver"
	default y
	depends on SOC_MT8390
    depends on DT_HAS_MEDIATEK_MT8188_PINCTRL_ENABLED
	help
	  Enable the MediaTek MT8390 PINCTRL driver.
```

## dts/bindings/audio/mediatek,mt8390-afe.yaml
```yaml
# Copyright (c) 2026, MediaTek
# SPDX-License-Identifier: Apache-2.0

description: |
  MediaTek MT8390 AFE (Audio Front End) controller.
  Supports eTDM_IN and eTDM_OUT audio paths with DMA via memif.
  Derived from Linux Documentation/devicetree/bindings/sound/mediatek,mt8188-afe.yaml.

compatible: "mediatek,mt8390-afe"

include: [base.yaml, pinctrl-device.yaml]

properties:
  reg:
    required: true

  pinctrl-0:
    required: true

  pinctrl-names:
    required: true

  interrupts:
    required: true

  clocks:
    required: true

  clock-names:
    required: true
    description: |
      Clock names list (23 entries):
        apll1, apll2,
        apll12_div0, apll12_div1, apll12_div2, apll12_div3, apll12_div9,
        top_a1sys_hp, top_aud_intbus, top_audio_h, top_audio_local_bus,
        top_i2so1, top_i2so2, top_i2si1, top_i2si2,
        apll1_d4, apll2_d4, apll12_div4,
        top_a2sys, top_aud_iec,
        infra_audio, infra_audio_26m, infra_i2s_dma

  mediatek,etdm-in1-cowork-source:
    type: int
    description: Cowork source for eTDM IN1 (1=IN2, 2=IN3, 3=IN4)

  mediatek,etdm-in2-cowork-source:
    type: int
    description: Cowork source for eTDM IN2 (0=IN1, 2=IN3, 3=IN4)

  mediatek,etdm-out1-cowork-source:
    type: int
    description: Cowork source for eTDM OUT1 (0=OUT2, 1=OUT3, 3=OUT4)

  mediatek,etdm-out2-cowork-source:
    type: int
    description: Cowork source for eTDM OUT2 (0=OUT1, 1=OUT3, 2=OUT4)

  mediatek,etdm-in1-multi-pin-mode:
    type: boolean
    description: Enable I2S multi-pin mode for eTDM IN1

  mediatek,etdm-in2-multi-pin-mode:
    type: boolean
    description: Enable I2S multi-pin mode for eTDM IN2

  mediatek,etdm-out1-multi-pin-mode:
    type: boolean
    description: Enable I2S multi-pin mode for eTDM OUT1

  mediatek,etdm-out2-multi-pin-mode:
    type: boolean
    description: Enable I2S multi-pin mode for eTDM OUT2

  mediatek,etdm-out3-multi-pin-mode:
    type: boolean
    description: Enable I2S multi-pin mode for eTDM OUT3
```

## dts/bindings/clock/mediatek,mt8390-apmixedsys.yaml
```yaml
# Copyright (c) 2026, MediaTek
# SPDX-License-Identifier: Apache-2.0

description: MediaTek MT8390 APMIXEDSYS PLL clock controller

compatible: "mediatek,mt8390-apmixedsys"

include: [clock-controller.yaml, base.yaml]

properties:
  "#clock-cells":
    const: 1

clock-cells:
  - name
```

## dts/bindings/clock/mediatek,mt8390-topckgen.yaml
```yaml
# Copyright (c) 2026, MediaTek
# SPDX-License-Identifier: Apache-2.0

description: MediaTek MT8390 TOPCKGEN mux+gate clock controller

compatible: "mediatek,mt8390-topckgen"

include: [clock-controller.yaml, base.yaml]

properties:
  "#clock-cells":
    const: 1

clock-cells:
  - name
```

## dts/bindings/gpio/mediatek,mt8188-gpio.yaml
```yaml
# Copyright (c) 2025 MediaTek
# SPDX-License-Identifier: Apache-2.0

description: MediaTek MT8188 GPIO

compatible: "mediatek,mt8188-gpio"

include: [gpio-controller.yaml, base.yaml]

properties:
  reg:
    required: true

  pinmux:
    type: phandles

  "#gpio-cells":
    const: 2

gpio-cells:
  - pin
  - flags
```

## dts/bindings/i2s/mediatek,mt8188-i2s.yaml
```yaml
# Copyright (c) 2025 MediaTek
# SPDX-License-Identifier: Apache-2.0

description: MediaTek MT8188 I2S

compatible: "mediatek,mt8188-i2s"

include: [base.yaml, pinctrl-device.yaml]

properties:
  reg:
    required: true

  interrupts:
    required: true
```

## dts/bindings/i2s/mediatek,mt8365-i2s.yaml
```yaml
# Copyright (c) 2025 MediaTek
# SPDX-License-Identifier: Apache-2.0

description: MediaTek MT8365 I2S

compatible: "mediatek,mt8365-i2s"

include: [base.yaml, i2s-controller.yaml, pinctrl-device.yaml]

properties:
  reg:
    required: true

  interrupts:
    required: true
```
